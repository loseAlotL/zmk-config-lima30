## boards/shields/lima30/Kconfig.defconfig
```kconfig
if SHIELD_LIMA30_LEFT

config ZMK_KEYBOARD_NAME
    default "lima30"

config ZMK_SPLIT_ROLE_CENTRAL
    default y

endif

if SHIELD_LIMA30_LEFT || SHIELD_LIMA30_RIGHT

config ZMK_SPLIT
    default y

endif
```

## boards/shields/lima30/Kconfig.shield
```kconfig
config SHIELD_LIMA30_LEFT
    def_bool $(shields_list_contains,lima30_left)

config SHIELD_LIMA30_RIGHT
    def_bool $(shields_list_contains,lima30_right)
```
